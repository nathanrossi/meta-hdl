## conf/layer.conf
```bitbake
BBPATH .= ":${LAYERDIR}"

BBFILES += "${LAYERDIR}/recipes-support/*/*.bb"
BBFILES += "${LAYERDIR}/recipes-simulation/*/*.bb"
BBFILES += "${LAYERDIR}/recipes-synthesis/*/*.bb"
BBFILES += "${LAYERDIR}/recipes-synthesis/*/*.bbappend"
BBFILES += "${LAYERDIR}/recipes-pnr/*/*.bb"
BBFILES += "${LAYERDIR}/recipes-fpga/*/*.bb"
BBFILES += "${LAYERDIR}/recipes-examples/*/*.bb"
BBFILES += "${LAYERDIR}/recipes-examples/*/*.bbappend"
BBFILES += "${LAYERDIR}/recipes-programmer/*/*.bb"
BBFILES += "${LAYERDIR}/recipes-programmer/*/*.bbappend"

BBFILE_COLLECTIONS += "hdl"
BBFILE_PATTERN_hdl = "^${LAYERDIR}/"
BBFILE_PRIORITY_hdl = "7"

LAYERDEPENDS_hdl = "core openembedded-layer meta-python"
LAYERSERIES_COMPAT_hdl = "hardknott"
```

## conf/machine/arty-lm32.conf
```bitbake
#@TYPE: Machine
#@NAME: arty-lm32
#@DESCRIPTION: Arty board LM32 cpu, litex base platform

# manual arch/tune definition
DEFAULTTUNE ?= "lm32"
AVAILTUNES += "lm32"
TUNEVALID[lm32] = ""
TUNE_FEATURES_tune-lm32 = "lm32"
TUNE_ARCH = "lm32"
TUNE_PKGARCH = "lm32"
PACKAGE_EXTRA_ARCHS = "lm32"
TUNE_CCARGS .= "-mbarrel-shift-enabled -mmultiply-enabled -mdivide-enabled -msign-extend-enabled"

TCLIBC = "newlib"

# unrecognized option for gnu hash styles (unsupported)
LINKER_HASH_STYLE = ""

# litex setup
MACHINEOVERRIDES =. "litex-platform:"
MACHINEOVERRIDES =. "fpga-artix7:"
LITEX_PLATFORM = "arty"
LITEX_TARGET = "net"

# For runqemu
EXTRA_IMAGEDEPENDS += "qemu-litex-native qemu-helper-native"
QB_SYSTEM_NAME = "qemu-litex/qemu-system-lm32"
QB_DEFAULT_KERNEL = "none"
QB_MACHINE = "-machine litex"
QB_OPT_APPEND = "-nographic -serial mon:stdio"
QB_NETWORK_DEVICE = "-net nic,netdev=net0,macaddr=@MAC@"
QB_DEFAULT_FSTYPE = "none"
QB_KERNEL_CMDLINE_APPEND ?= ""

# load bios
QB_OPT_APPEND_append = " -bios ${DEPLOY_DIR_IMAGE}/bios-${MACHINE}.bin"
QB_OPT_APPEND_append = " \
    -drive if=mtd,format=qcow2,file=${DEPLOY_DIR_IMAGE}/litex-image-qemu.qcow2 \
    -global litex_ssi.spiflash=n25q128a13 \
    "
QB_SLIRP_OPT = "-netdev user,id=net0,net=192.168.100.0/24,host=192.168.100.100,dhcpstart=192.168.100.50,hostfwd=tcp::2222-:22,hostfwd=tcp::2323-:23,tftp=${DEPLOY_DIR_IMAGE}"
```

## conf/machine/fomu.conf
```bitbake
#@TYPE: Machine
#@NAME: fomu
#@DESCRIPTION: fomu with 32-bit RISC-V litex SoC

DEFAULTTUNE ?= "riscv32"
FPGA_FAMILY ?= "ice40"

require conf/machine/include/riscv/tune-riscv.inc

TUNE_CCARGS .= "-march=rv32i_zicsr -mabi=ilp32"

# foboot needs newlib
TCLIBC = "newlib"
```

## conf/machine/ice40-up5k-b-evn.conf
```bitbake
#@TYPE: Machine
#@NAME: ice40-up5k-b-evn
#@DESCRIPTION: ice40 UP5K Evaluation Board

# lm32 does not support any hash styles
LINKER_HASH_STYLE = ""
# manual arch/tune definition
DEFAULTTUNE ?= "lm32"
AVAILTUNES += "lm32"
TUNEVALID[lm32] = ""
TUNE_FEATURES_tune-lm32 = "lm32"
TUNE_ARCH = "lm32"
TUNE_PKGARCH = "lm32"
PACKAGE_EXTRA_ARCHS = "lm32"
TUNE_CCARGS .= "-mbarrel-shift-enabled -mmultiply-enabled -mdivide-enabled -msign-extend-enabled"

TCLIBC = "newlib"

# litex setup
MACHINEOVERRIDES =. "litex-platform:"
MACHINEOVERRIDES =. "fpga-ice40:"
LITEX_PLATFORM = "ice40_up5k_b_evn"
LITEX_TARGET = "base"
LITEX_CPU_VARIANT = "minimal"

# For runqemu
EXTRA_IMAGEDEPENDS += "qemu-litex-native qemu-helper-native"
QB_SYSTEM_NAME = "qemu-litex/qemu-system-lm32"
QB_DEFAULT_KERNEL = "none"
QB_MACHINE = "-machine litex"
QB_OPT_APPEND = "-nographic -serial mon:stdio"
QB_NETWORK_DEVICE = ""
QB_DEFAULT_FSTYPE = "none"
QB_KERNEL_CMDLINE_APPEND ?= ""

# setup flash, this config has no in-built bios
QB_OPT_APPEND_append = " \
    -drive if=mtd,format=qcow2,file=${DEPLOY_DIR_IMAGE}/litex-image-qemu.qcow2 \
    -global litex_ssi.spiflash=n25q032a13 \
    "
```

## conf/machine/lm32.conf
```bitbake
#@TYPE: Machine
#@NAME: lm32
#@DESCRIPTION: LaticeMico32 Generic Machine

# manual arch/tune definition
DEFAULTTUNE ?= "lm32"
AVAILTUNES += "lm32"
TUNEVALID[lm32] = ""
TUNE_FEATURES:tune-lm32 = "lm32"
TUNE_ARCH = "lm32"
TUNE_PKGARCH = "lm32"

TCLIBC = "newlib"

# unrecognized option for gnu hash styles (unsupported)
LINKER_HASH_STYLE = ""
```

## conf/machine/picosoc-hx8k.conf
```bitbake
#@TYPE: Machine
#@NAME: picosoc-hx8k
#@DESCRIPTION: picosoc with picorv32 RISC-V processor on HX8K Lattice Board

# manual arch/tune definition
DEFAULTTUNE ?= "riscv32"
AVAILTUNES += "riscv32"
TUNEVALID[riscv32] = "Enable 32-bit RISC-V optimizations"
TUNE_FEATURES_tune-riscv32 = "riscv32"
TUNE_ARCH = "riscv32"
TUNE_PKGARCH = "riscv32"
PACKAGE_EXTRA_ARCHS = "riscv32"
TUNE_CCARGS .= "-march=rv32imc -mabi=ilp32"

# this target is a processor without linux support, newlib for libc
TCLIBC = "newlib"

# unrecognized option for gnu hash styles (unsupported)
LINKER_HASH_STYLE = ""
```

## conf/machine/picosoc.conf
```bitbake
#@TYPE: Machine
#@NAME: picosoc
#@DESCRIPTION: picosoc with picorv32 RISC-V processor

DEFAULTTUNE ?= "riscv32"
FPGA_FAMILY ?= "ice40"

require conf/machine/include/riscv/tune-riscv.inc

TUNE_CCARGS .= "-march=rv32imc -mabi=ilp32"

# this target is a processor without linux support
TCLIBC = "baremetal"
```

## conf/machine/versa-ecp5.conf
```bitbake
#@TYPE: Machine
#@NAME: versa-ecp5-vexriscv
#@DESCRIPTION: Lattice Versa ECP5 Evaluation Board

DEFAULTTUNE ?= "riscv32"
FPGA_FAMILY ?= "ecp5"

require conf/machine/include/riscv/tune-riscv.inc

TUNE_CCARGS .= "-march=rv32ima -mabi=ilp32"

SERIAL_CONSOLES ?= "115200;ttyLXU0"

RISCV_SBI_PLAT ?= "litex/vexriscv"

PREFERRED_PROVIDER_virtual/kernel = "linux-versa-ecp5-vexriscv"
KERNEL_IMAGETYPE = "Image"

IMAGE_FSTYPES += "cpio"

# depend on the bitstream/firmware
EXTRA_IMAGEDEPENDS += "linux-on-litex-vexriscv opensbi"

# this is needed to get meta-riscv's glibc append
MACHINEOVERRIDES .= ":qemuriscv32"
```
